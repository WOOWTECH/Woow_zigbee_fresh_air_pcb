## firmware/main/Kconfig.projbuild
```kconfig
menu "WO30109 新風控制器"
    choice FA_BOARD
        prompt "板子版本"
        default FA_BOARD_V33
        help
            V3.3 起 DI 腳位改了（與 NFC I2C 一起重排），並多了 NFC（U6 ST25DV04KC）。
        config FA_BOARD_V33
            bool "V3.3（DI＋NFC）"
        config FA_BOARD_V32
            bool "V3.2（DI，沒有 NFC）"
    endchoice

    config FA_DEVKIT_RGB
        bool "開發板模式：板載 RGB 燈（GPIO8 WS2812）顯示狀態與 K1–K4"
        default n
        help
            給 ESP32-C6-DevKitC-1 這類有板載 WS2812 的開發板用（規格 D8）。燈號的亮滅與 GPIO2 狀態燈相同，
            亮的時候用顏色顯示繼電器：K1 紅、K2 綠、K3 藍、K4 開時加白；正常且全關時全暗。
            正式板子 GPIO8 沒接東西，不要開。

    config FA_DEVKIT_LIGHT
        bool "開發板：多一個 Matter 彩色燈（EP21）"
        depends on FA_DEVKIT_RGB && !FA_DEVKIT_COVER_ONLY && !FA_DEVKIT_HVAC_ONLY
        default n
        help
            板載 RGB 燈同時當 Matter Extended Color Light（色盤、色溫 2000–6000K、亮度），給 controller 測燈用。
            controller 開燈時顯示它設的顏色，關燈回到 K1–K4 狀態顯示。endpoint 上限要 ≥22。
            預設關：4DI/DO 版本不出現燈（使用者 10/07 要求拿掉）。
    config FA_DEVKIT_LIGHT_ONLY
        bool "實驗：整台裝置只有彩色燈（不建插座、感測器、下拉選單）"
        depends on FA_DEVKIT_RGB
        select FA_DEVKIT_LIGHT
        default n
        help
            測試第三方生態系（例如塗鴉）遇到「單純一顆 Matter 彩色燈」時給什麼面板，
            用來判斷改裝置結構有沒有用。繼電器、DI 本地功能照常，只是不出現在 Matter。

    config FA_DEVKIT_COVER_ONLY
        bool "實驗：整台裝置只有窗簾（K1＝開、K2＝關，時間式比例控制）"
        depends on FA_DEVKIT_RGB && !FA_DEVKIT_LIGHT_ONLY && !FA_DEVKIT_HVAC_ONLY
        default n
        help
            Matter 只建 Window Covering（Drapery，可設百分比）＋「窗簾行程時間」下拉選單（5–180 秒）。
            位置由行程時間推算（fa_core/fa_cover），停下時存 NVS；換方向先停 500ms；到端點多跑行程的 1/10。
            BOOT 短按＝開／停／關循環；板載 RGB：開中綠、關中紅、停著白光亮度＝開度。DI 與遙控器不接繼電器。

    config FA_DEVKIT_HVAC_ONLY
        bool "實驗：整台裝置只有新風溫控（冷暖＋三段風速，Room Air Conditioner）"
        depends on FA_DEVKIT_RGB && !FA_DEVKIT_LIGHT_ONLY
        default n
        help
            Matter 只建一個 Room Air Conditioner endpoint：開關、溫控（關／製冷／加熱）、風速（關／低／中／高／自動）、攝氏。
            溫控邏輯在 fa_core/fa_hvac（±FA_HVAC_HYST、最少開／關 FA_HVAC_MIN_CYCLE_S、加熱關後吹風 60 秒）。
            開發板沒有繼電器：輸出看 log 與板載 RGB（加熱紅、製冷藍、送風綠，亮度＝風速）。
            室溫先用 ESP32-C6 內建溫度感測器（量的是晶片溫度，比室溫高；只用來測控制與各 App 面板）。

    config FA_HVAC_THERMOSTAT
        bool "溫控改用純 Thermostat 類型（沒有電源、風速；塗鴉面板實驗）"
        depends on FA_DEVKIT_HVAC_ONLY
        default n
        help
            只建一個 Thermostat（0x0301）endpoint，只有 Thermostat cluster（關／製冷／加熱）。
            模式關＝全關；風速固定自動（依溫差選低中高）。
            用來測塗鴉對單一功能 Thermostat 會不會給原生面板（Room Air Conditioner 只拿到通用頁面）。

    config FA_HVAC_HYST_CENTI
        int "溫控緩衝（0.01 °C）"
        depends on FA_DEVKIT_HVAC_ONLY
        range 10 300
        default 50

    config FA_HVAC_MIN_CYCLE_S
        int "加熱／製冷最少開、最少關（秒）"
        depends on FA_DEVKIT_HVAC_ONLY
        range 0 1800
        default 180

    config FA_HVAC_TEMP_OFFSET_CENTI
        int "室溫補償（0.01 °C，加在晶片溫度上）"
        depends on FA_DEVKIT_HVAC_ONLY
        range -5000 5000
        default 0

    choice FA_DEVKIT_RGB_ORDER
        prompt "板載 RGB 燈的位元組順序"
        depends on FA_DEVKIT_RGB
        default FA_DEVKIT_RGB_ORDER_RGB
        help
            標準 WS2812 是 GRB。使用者的 ESP32-C6 開發板實測是 RGB（用 GRB 送時紅綠對調）。
            換開發板時如果紅綠顛倒，改這個。
        config FA_DEVKIT_RGB_ORDER_RGB
            bool "RGB（使用者的 C6 開發板）"
        config FA_DEVKIT_RGB_ORDER_GRB
            bool "GRB（標準 WS2812）"
    endchoice

    config FA_RELAY_PWM_HOLD
        bool "繼電器 PWM 降壓保持（吸合後改 PWM，省 12V 電流）"
        default y
        help
            每顆線圈先全壓 FA_RELAY_PULLIN_MS，之後用 LEDC 以 FA_RELAY_PWM_HZ、FA_RELAY_HOLD_PCT duty 保持。
            60% duty、B5819W 續流時線圈平均 7.08V（額定 59%，Omron G5Q-1 要求 ≥30%），12V 端每顆 11.8mA（全壓 33.3mA）。
            關掉就回到 V3.0 的 GPIO 全壓驅動，FA_MAX_RELAYS_ON 預設回 3。

    config FA_RELAY_PULLIN_MS
        int "全壓吸合時間 (ms)"
        depends on FA_RELAY_PWM_HOLD
        range 100 1000
        default 100
        help
            Omron G5Q-1 規格書 p.6：降壓保持前要先加額定電壓至少 100ms。

    config FA_RELAY_HOLD_PCT
        int "保持 duty (%)"
        depends on FA_RELAY_PWM_HOLD
        range 50 100
        default 60
        help
            Omron 驗證 PWM 保持（-PW 型）的條件是 duty ≥50%、≥10kHz、續流二極體 Vf ≤0.4V。
            標準版 G5Q-1 沒有 PWM 背書，只規定保持電壓 ≥30%；取 60% 留給溫升（線圈電阻 +0.4%/°C）與振動。

    config FA_RELAY_PWM_HZ
        int "PWM 頻率 (Hz)"
        depends on FA_RELAY_PWM_HOLD
        range 10000 40000
        default 20000

    config FA_MAX_RELAYS_ON
        int "同時吸合的繼電器上限"
        range 1 4
        default 4 if FA_RELAY_PWM_HOLD
        default 3
        help
            12V 電源 IRM-02-12 額定 167mA、110%（184mA）進保護。12V 側常態約 26mA，+10dBm 發射峰值再多 32mA。
            PWM 保持（預設）：3 顆保持＋1 顆吸合＋發射 ≈ 127mA，可以 4 顆全開（吸合錯開 ≥ FA_RELAY_PULLIN_MS）。
            全壓驅動：4 顆＋發射峰值約 191mA，超過保護點，所以上限 3。

    config FA_TX_POWER
        int "802.15.4（Thread）發射功率 (dBm)"
        range -15 20
        default 10
        help
            ESP-IDF 的 802.15.4 驅動預設開到最大（ESP32-C6 為 +20dBm），峰值約 302mA@3.3V，會讓 12V 電源
            （IRM-02-12）瞬間超過 110% 保護點；+10dBm 峰值約 165mA@3.3V（12V 側 +30mA，毫秒級），電源預算以此計算。
            Thread 啟動後由 fa_matter.cpp 設定。
    config FA_INTERLOCK_DEAD_MS
        int "風速切換：斷開到吸合的間隔 (ms)"
        default 200
    config FA_RELAY_STAGGER_MS
        int "兩顆繼電器吸合的最小間隔 (ms)"
        default 110 if FA_RELAY_PWM_HOLD
        default 50
        help
            PWM 保持時要大於 FA_RELAY_PULLIN_MS，確保同一時間最多 1 顆在全壓吸合（電源預算的前提）。
    choice FA_PRESET
        prompt "出廠預設 DO 模式（V3.2 拿掉指撥，改軟體設定）"
        default FA_PRESET_FAN3
        help
            設成「互鎖」的幾路自動成一組（風速）。之後可在 Home Assistant／維護網頁改（V4 Matter），存在 NVS。
        config FA_PRESET_FAN3
            bool "三段風速＋1 路：K1–K3 互鎖、K4 自鎖"
        config FA_PRESET_FAN2
            bool "兩段風速＋2 路：K1–K2 互鎖、K3/K4 自鎖"
        config FA_PRESET_4CH
            bool "4 路獨立：全部自鎖"
        config FA_PRESET_SEL4
            bool "4 路互斥：全部互鎖"
    endchoice

    choice FA_DI_DEFAULT
        prompt "出廠預設 DI 模式（4 路相同；遙控器 4 鍵同步）"
        default FA_DI_DEFAULT_HOLD
        config FA_DI_DEFAULT_HOLD
            bool "持續：接通期間作動，斷開停止"
        config FA_DI_DEFAULT_PRESS
            bool "按一次：接通那一刻觸發一次"
        config FA_DI_DEFAULT_OFF
            bool "全關：不控制繼電器"
    endchoice

    config FA_JOG_MS
        int "出廠預設點動時間 (ms)"
        range 500 3600000
        default 1000
endmenu
```
